## components/device-diagnostics/Kconfig
```kconfig
menu "Device diagnostics"

    config DEVICE_DIAGNOSTICS_GROUP
        string "Diagnostics multicast group"
        default "239.255.10.2"
        help
            IPv4 multicast group that diagnostics messages are sent to, with the
            Wi-Fi signal strength and the uptime. Senders and receivers must use
            the same group.

    config DEVICE_DIAGNOSTICS_PORT
        int "Diagnostics UDP port"
        range 1 65535
        default 45000
        help
            UDP port that diagnostics messages are sent to. Senders and receivers
            must use the same port.

    config DEVICE_DIAGNOSTICS_INTERVAL
        int "Diagnostics interval (s)"
        range 0 86400
        default 60
        help
            Seconds between diagnostics messages. 0 turns them off. Only used by
            devices that send diagnostics.

endmenu
```

## components/ota-server/Kconfig
```kconfig
menu "OTA server"

    config OTA_SERVER_PORT
        int "HTTPS port"
        range 1 65535
        default 443
        help
            TCP port of the update server. tools/ota_push.py uses 443 unless told otherwise.

    config OTA_SERVER_CONFIRM_TIMEOUT
        int "Confirm timeout (s)"
        range 10 86400
        default 300
        help
            Seconds a new firmware has to confirm that it works, by calling
            ota_server_mark_valid(). If it does not, the device goes back to the
            previous firmware.

endmenu
```

## firmware/receiver/main/Kconfig.projbuild
```kconfig
menu "Receiver Configuration"

    menu "Multicast"
        config MULTICAST_GROUP
            string "Air quality multicast group"
            default "239.255.10.1"
            help
                IPv4 multicast group to receive air quality messages from.
                Must match the air quality multicast group set in the sensors.

        config MULTICAST_PORT
            int "UDP port"
            range 1 65535
            default 45000
            help
                UDP port that air quality messages are sent to. Must match the port set in the sensors.
    endmenu

endmenu
```

## main/Kconfig.projbuild
```kconfig
menu "IKEA Vindriktning Configuration"

    config UART_PORT_NUM
        int "UART port number"
        range 0 2 if IDF_TARGET_ESP32 || IDF_TARGET_ESP32S3
        default 2 if IDF_TARGET_ESP32 || IDF_TARGET_ESP32S3
        range 0 1 if IDF_TARGET_ESP32S2 || IDF_TARGET_ESP32C3 || IDF_TARGET_ESP32C2 || IDF_TARGET_ESP32H2
        default 1 if IDF_TARGET_ESP32S2 || IDF_TARGET_ESP32C3 || IDF_TARGET_ESP32C2 || IDF_TARGET_ESP32H2
        range 0 1
        default 1
        help
            UART communication port number.
            See UART documentation for available port numbers.

    config UART_BAUD_RATE
        int "UART communication speed"
        range 1200 115200
        default 9600
        help
            UART communication speed.

    config UART_RXD
        int "UART RXD pin number"
        default 20
        help
            GPIO number for UART RX pin. See UART documentation for more information
            about available pin numbers for UART.

    menu "Wi-Fi"
        config WIFI_SSID
            string "SSID"
            default ""
            help
                Name of the Wi-Fi network to connect to.

        config WIFI_PASSWORD
            string "Password"
            default ""
            help
                Password of the Wi-Fi network. Leave empty for an open network.
    endmenu

    menu "Multicast"
        config MULTICAST_SOURCE
            string "Device name"
            default "vindriktning"
            help
                Name sent in every message, so receivers can tell devices apart.

        config MULTICAST_GROUP
            string "Air quality multicast group"
            default "239.255.10.1"
            help
                IPv4 multicast group that air quality messages are sent to.
                Receivers join this group to get them.

        config MULTICAST_PORT
            int "UDP port"
            range 1 65535
            default 45000
            help
                UDP port that messages are sent to.

        config MULTICAST_TTL
            int "TTL"
            range 1 255
            default 1
            help
                Number of routers messages may pass. 1 keeps them on the local network.
    endmenu

endmenu
```

## receiver/main/Kconfig.projbuild
```kconfig
menu "Vindriktning Receiver Configuration"

    menu "Multicast"
        config MULTICAST_GROUP
            string "Air quality multicast group"
            default "239.255.10.1"
            help
                IPv4 multicast group to receive air quality messages from.
                Must match the group set in the sensor firmware.

        config MULTICAST_PORT
            int "UDP port"
            range 1 65535
            default 45000
            help
                UDP port that messages are sent to. Must match the port set in the sensor firmware.
    endmenu

endmenu
```
